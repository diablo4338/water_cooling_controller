## firmware/sdkconfig.defaults
```kconfig
# Release-oriented baseline for the ESP32-C3 firmware build.

CONFIG_PARTITION_TABLE_SINGLE_APP_LARGE=y

CONFIG_BOOTLOADER_COMPILER_OPTIMIZATION_SIZE=y
CONFIG_BOOTLOADER_LOG_LEVEL_WARN=y

CONFIG_COMPILER_OPTIMIZATION_SIZE=y
CONFIG_COMPILER_OPTIMIZATION_ASSERTIONS_DISABLE=y

CONFIG_LOG_DEFAULT_LEVEL_WARN=y
CONFIG_LOG_MAXIMUM_EQUALS_DEFAULT=y
CONFIG_BT_ENABLED=y
CONFIG_BT_BLE_ENABLED=y
CONFIG_BT_NIMBLE_ENABLED=y
CONFIG_BT_NIMBLE_LOG_LEVEL_WARNING=y

# CONFIG_ESP_GDBSTUB_ENABLED is not set
# CONFIG_FREERTOS_ENABLE_TASK_SNAPSHOT is not set

CONFIG_ESP_COREDUMP_ENABLE_TO_NONE=y
CONFIG_HEAP_POISONING_DISABLED=y
CONFIG_HEAP_TRACING_OFF=y

# CONFIG_ESP_WIFI_ENABLED is not set
# CONFIG_ETH_ENABLED is not set
```
